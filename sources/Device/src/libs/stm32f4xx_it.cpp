#include "FPGA/FPGA.h"


#ifdef __cplusplus
extern "C" {
#endif


//////////////////////////////////////////////////////////////////////////////////////////////////////////////////////////////////////////////////////
void NMI_Handler()
{
}


//----------------------------------------------------------------------------------------------------------------------------------------------------
void HardFault_Handler()
{
    while (1)
    {
    }
}


//----------------------------------------------------------------------------------------------------------------------------------------------------
void MemManage_Handler()
{
    while (1)
    {
    }
}


//----------------------------------------------------------------------------------------------------------------------------------------------------
void BusFault_Handler()
{
    while (1)
    {
    }
}


//----------------------------------------------------------------------------------------------------------------------------------------------------
void UsageFault_Handler()
{
    while (1)
    {
    }
}


//----------------------------------------------------------------------------------------------------------------------------------------------------
void SVC_Handler()
{
}


//----------------------------------------------------------------------------------------------------------------------------------------------------
void DebugMon_Handler()
{
}


//----------------------------------------------------------------------------------------------------------------------------------------------------
void PendSV_Handler()
{
}


//----------------------------------------------------------------------------------------------------------------------------------------------------
void SysTick_Handler()
{
    HAL_IncTick();
}


//----------------------------------------------------------------------------------------------------------------------------------------------------
void ADC_IRQHandler()
{
    HAL_ADC_IRQHandler(&handleADC);
}


//----------------------------------------------------------------------------------------------------------------------------------------------------
// This interrupt call soft NSS for spi (see Hardware::SPIforPanel.c::
// PanelInit() and HAL_GPIO_EXTI_Callback())
void EXTI9_5_IRQHandler()
{
    HAL_GPIO_EXTI_IRQHandler(GPIO_PIN_6);
}


//----------------------------------------------------------------------------------------------------------------------------------------------------
// See Hardware::SPIforPanel.c::HAL_SPI_RxCpltCallback()
void SPI1_IRQHandler()
{
    HAL_SPI_IRQHandler(&handleSPI);
}


//----------------------------------------------------------------------------------------------------------------------------------------------------
// Прерывание для флешки
void OTG_FS_IRQHandler()
{
    HAL_HCD_IRQHandler(&handleHCD);
}


//----------------------------------------------------------------------------------------------------------------------------------------------------
void DMA1_Stream5_IRQHandler()
{
    HAL_DMA_IRQHandler(handleDAC.DMA_Handle1);
}
    

//----------------------------------------------------------------------------------------------------------------------------------------------------
void DMA2_Stream0_IRQHandler()
{
    HAL_DMA_IRQHandler(&handleDMA_RAM);
}


//----------------------------------------------------------------------------------------------------------------------------------------------------
// Внешнее прерывание для чтения флага готовности точки в режиме поточечного вывода (Pin 116 - PD2)
void EXTI2_IRQHandler()
{
    HAL_GPIO_EXTI_IRQHandler(GPIO_PIN_2);
}


//----------------------------------------------------------------------------------------------------------------------------------------------------
void HAL_ADC_ConvCpltCallback(ADC_HandleTypeDef* hadc)
{
    extern uint16 adcValueFPGA;
    adcValueFPGA = (uint16)HAL_ADC_GetValue(hadc);
}

#ifdef __cplusplus
}
#endif
